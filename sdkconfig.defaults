## sdkconfig.defaults
```kconfig
# IDF 5.x port of the aideck ESP32 firmware configuration.
# Carries over the settings that matter from the 4.3-era sdkconfig
# (kept as sdkconfig.idf43 for reference) using the renamed 5.x keys.

# NINA-W102 module: 2 MB flash.
CONFIG_ESPTOOLPY_FLASHSIZE_2MB=y

# Log/console UART: UART1 on the NINA_SYSBOOT pin (TX 0, RX 25), like 4.3.
CONFIG_ESP_CONSOLE_UART_CUSTOM=y
CONFIG_ESP_CONSOLE_UART_CUSTOM_NUM_1=y
CONFIG_ESP_CONSOLE_UART_TX_GPIO=0
CONFIG_ESP_CONSOLE_UART_RX_GPIO=25
CONFIG_ESP_CONSOLE_UART_BAUDRATE=115200

# The firmware's raw vTaskDelay() counts assume the 4.3-era 100 Hz tick.
CONFIG_FREERTOS_HZ=100

CONFIG_ESP_MAIN_TASK_STACK_SIZE=5000

# Memory bounds (see external/README.md "Local TCP fix"): the NINA has ~40 KB
# of free heap and the WiFi blob dies when lwIP/driver buffering exhausts it.
CONFIG_ESP_WIFI_STATIC_RX_BUFFER_NUM=10
CONFIG_ESP_WIFI_DYNAMIC_RX_BUFFER_NUM=32
CONFIG_ESP_WIFI_DYNAMIC_TX_BUFFER_NUM=8
CONFIG_LWIP_TCP_SND_BUF_DEFAULT=16384
CONFIG_LWIP_TCP_WND_DEFAULT=5744
```
